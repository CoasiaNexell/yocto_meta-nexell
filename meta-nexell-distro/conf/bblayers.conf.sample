## meta-nexell-distro/conf/bblayers.conf.sample
```bitbake
# LAYER_CONF_VERSION is increased each time build/conf/bblayers.conf
# changes incompatibly
LCONF_VERSION = "6"

BBPATH = "${TOPDIR}"
BBFILES ?= ""

BSPPATH := "${@os.path.abspath(os.path.dirname(d.getVar('FILE', True)) + '/../../..')}"

BBLAYERS ?= " \
  ${BSPPATH}/layers/poky/meta \
  ${BSPPATH}/layers/poky/meta-poky \
  ${BSPPATH}/layers/poky/meta-yocto-bsp \
  ${BSPPATH}/layers/meta-nexell/meta-nexell-distro \
  ${BSPPATH}/layers/meta-qt5 \
  ${BSPPATH}/layers/meta-openembedded/meta-multimedia \
  ${BSPPATH}/layers/meta-openembedded/meta-oe \
  ${BSPPATH}/layers/meta-openembedded/meta-python \
  ${BSPPATH}/layers/meta-openembedded/meta-networking \
  "

BBLAYERS_NON_REMOVABLE ?= " \
  ${BSPPATH}/poky/meta \
  ${BSPPATH}/poky/meta-poky \
  "
```

## meta-nexell-distro/conf/layer.conf
```bitbake
# We have a conf and classes directory, add to BBPATH
BBPATH .= ":${LAYERDIR}"

# We have a recipes-* directories, add to BBFILES
BBFILES += "${LAYERDIR}/recipes-*/*/*.bb \
        ${LAYERDIR}/recipes-*/*/*/*.bb \
	${LAYERDIR}/recipes-*/*/*.bbappend"

BBFILE_COLLECTIONS += "nexell"

BBFILE_PATTERN_nexell = "^${LAYERDIR}/"
BBFILE_PRIORITY_nexell = "6"

LAYERSERIES_COMPAT_nxp3220 = "dunfell"
LAYERSERIES_COMPAT_nexell = "dunfell"
```

## meta-nexell-distro/conf/machine/include/nexell-base.inc
```bitbake
inherit linux-nexell-base

SOC_FAMILY = "Nexell"

NEXELL_BOARD_SOCNAME ?= "${BSP_TARGET_SOCNAME}"

IMAGE_FSTYPES ?= "tar.bz2 ext4"
INITRAMFS_IMAGE ?= "nexell-ramdisk"

# If you need to change below function, you can see the classes/linux-nexell-base.bbclass
KERNEL_IMAGETYPE_${MACHINE} ?= "${@get_kernel_image_type(d,"${MACHINE}")}"
DEFAULTTUNE_${MACHINE} ?= "${@get_defaulttune_type(d,"${MACHINE}")}"

MACHINE_FEATURES += "apm usbhost keyboard vfat ext2 screen mouse touchscreen bluetooth wifi sdio"
MACHINE_FEATURES_BACKFILL_CONSIDERED = "rtc"
MACHINE_EXTRA_RRECOMMENDS += "kernel-modules kernel-devicetree"

DEFAULT_TIMEZONE="Asia/Seoul"

IMAGE_OVERHEAD_FACTOR="1.0"

PREFERRED_PROVIDER_virtual/kernel ?= "linux-${NEXELL_BOARD_SOCNAME}"
PREFERRED_PROVIDER_virtual/bootloader ?= "u-boot-nexell"

# default type is pressure sensitive touch screen
# If yoc need another type, override 'NEXELL_TOUCH_CLASS' in machine/conf/<board_name>
NEXELL_TOUCH_CLASS = "PRESSES"

# nexell device id
NEXELL_DEVID_USB ?= "0"
NEXELL_DEVID_SPI ?= "1"
NEXELL_DEVID_NAND ?= "2"
NEXELL_DEVID_SDMMC ?= "3"
NEXELL_DEVID_SDFS ?= "4"
NEXELL_DEVID_UART ?= "5"

# nexell device port number
NEXELL_PORT_EMMC ?= "2"
NEXELL_PORT_SD ?= "0"
```

## meta-nexell-distro/conf/machine/include/nexell-mem-1g.inc
```bitbake
MEM_LOAD_ADDR ?= "0x7fcc0000"
MEM_JUMP_ADDR ?= "0x7fd00800"
MEM_SECURE_LOAD_ADDR ?= "0x7fb00000"
MEM_SECURE_JUMP_ADDR ?= "0x00000000"
MEM_NON_SECURE_LOAD_ADDR ?= "0x7df00000"
MEM_NON_SECURE_JUMP_ADDR ?= "0x00000000"
```

## meta-nexell-distro/conf/machine/include/nexell-mem-2g.inc
```bitbake
MEM_LOAD_ADDR="0xbfcc0000"
MEM_JUMP_ADDR="0xbfd00800"
MEM_SECURE_LOAD_ADDR="0xbfb00000"
MEM_SECURE_JUMP_ADDR="0x00000000"
MEM_NON_SECURE_LOAD_ADDR="0xbdf00000"
MEM_NON_SECURE_JUMP_ADDR="0x00000000"
```

## meta-nexell-distro/conf/machine/include/nexell-mem-512mb.inc
```bitbake
MEM_LOAD_ADDR ?= "0x9fcc0000"
MEM_JUMP_ADDR ?= "0x9fd00800"
MEM_SECURE_LOAD_ADDR ?= "0x9fb00000"
MEM_SECURE_JUMP_ADDR ?= "0x00000000"
MEM_NON_SECURE_LOAD_ADDR ?= "0x9df00000"
MEM_NON_SECURE_JUMP_ADDR ?= "0x00000000"
```

## meta-nexell-distro/conf/machine/include/nexell-tools.inc
```bitbake
# for tools path
NEXELL_TOOLS_PATH ?= "${BSP_TOOLS_DIR}"
NEXELL_SECURE_TOOLS_PATH ?= "${NEXELL_TOOLS_PATH}/secure_tools"
NEXELL_CONVERT_TOOLS_PATH ?= "${NEXELL_TOOLS_PATH}/convert_tools"
NEXELL_NSIH_TOOLS_PATH ?= "${NEXELL_CONVERT_TOOLS_PATH}"
NEXELL_FUSING_TOOLS_PATH ?= "${NEXELL_TOOLS_PATH}/fusing_tools"
NEXELL_SWU_SCRIPTS_PATH ?= "${NEXELL_TOOLS_PATH}/scripts"

# for swu_config & board_partmap
NEXELL_SWU_CONFIG ?= "${BSP_FILES_DIR}/swu/${BSP_TARGET_MACHINE}"
NEXELL_BOARD_PARTMAP_PATH ?= "${BSP_FILES_DIR}/partmap"

# for Secure bin
NEXELL_SECURE_BINGEN ?= "${NEXELL_SECURE_TOOLS_PATH}/SECURE_BINGEN"
NEXELL_RSA_SIGN_PSS ?= "${NEXELL_SECURE_TOOLS_PATH}/rsa_sign_pss"
NEXELL_NSIHTXTMOD ?= "${NEXELL_NSIH_TOOLS_PATH}/nsihtxtmod_yocto.py"
NEXELL_NSIHBINGEN ?= "${NEXELL_NSIH_TOOLS_PATH}/nsihbingen_yocto.py"
NEXELL_NSIHDUMMYFILE ?= "${NEXELL_NSIH_TOOLS_PATH}/nsih-dummy.txt"

#NEXELL_AES_KEY =
NEXELL_PRIVATE_KEY ?= "${NEXELL_SECURE_TOOLS_PATH}/private_key.pem"

# For make image
NEXELL_TOOL_MKIMAGE ?= "${NEXELL_CONVERT_TOOLS_PATH}/mkimage"
NEXELL_TOOL_MKENVIMAGE ?= "${NEXELL_CONVERT_TOOLS_PATH}/mkenvimage"
NEXELL_TOOL_MAKE_EXT4FS ?= "${NEXELL_CONVERT_TOOLS_PATH}/make_ext4fs"
NEXELL_TOOL_MKROOTFS_IMAGE ?= "${NEXELL_CONVERT_TOOLS_PATH}/mkrootfs_image.sh"
NEXELL_TOOL_EXT2SIMG ?= "${NEXELL_CONVERT_TOOLS_PATH}/ext2simg"

# For swu image
NEXELL_TOOL_SWU_IMAGE ?= "${NEXELL_SWU_SCRIPTS_PATH}/swu_image.sh"
```

## meta-nexell-distro/conf/machine/include/s5p4418-machine.inc
```bitbake
# RAM Size : "512mb" , "1g", "2g"
NEXELL_MEM_SIZE ?= "2g"

require conf/machine/include/tune-cortexa9.inc
include nexell-base.inc
include nexell-tools.inc
include nexell-mem-${NEXELL_MEM_SIZE}.inc

# 32bit machine = 32/arm, 64bit machine = 64/arm64
ARM_ARCH = "arm"
ARCH_TYPE_NUM = "32"
ARCH_TYPE = "arm32"

NEXELL_KERNEL_VER ?= "4"
NEXELL_ARM_SECURE ?= "n"
NEXELL_CHIPNAME ?= "nxp4330"
NEXELL_DEV_PORTNUM ?= "0"
NEXELL_SYSLOG ?= "n"

# ------------------------------------------------------------
# Nexell BL1 Configuration
# ------------------------------------------------------------
# BL1
BL1_BUILD_CONFIG='BOARD="${NEXELL_BL1_BOARD_NAME}" KERNEL_VER="${NEXELL_KERNEL_VER}" ARM_SECURE="${NEXELL_ARM_SECURE}" CHIPNAME="${NEXELL_CHIPNAME}" DEVICE_PORT="${NEXELL_DEV_PORTNUM}" SYSLOG="${NEXELL_SYSLOG}"'
#BL1_BIN='bl1-${NEXELL_BL1_IMAGE_NAME}.bin'
#BL1_FINAL_BIN='bl1-${NEXELL_BL1_FINAL_IMAGE_NAME}.bin'
#BL1_BUILD_CONFIG ?= 'BOARD="${NEXELL_BOARD_NAME}" KERNEL_VER="${NEXELL_KERNEL_VER}" ARM_SECURE="${NEXELL_ARM_SECURE}" CHIPNAME="${NEXELL_CHIPNAME}" DEVICE_PORT="${NEXELL_DEV_PORTNUM}" SYSLOG="${NEXELL_SYSLOG}"'
BL1_BIN ?= 'bl1-${NEXELL_BOARD_NAME}.bin'
BL1_FINAL_BIN ?= 'bl1-${BSP_TARGET_BOARD_PREFIX}.bin'
BL1_EMMCBOOT ?= 'bl1-emmcboot.bin'
BL1_SECURE_EMMCBOOT ?= 'bl1-emmcboot.img'

# ------------------------------------------------------------
# Nexell BL2 Configuration
# ------------------------------------------------------------
BL2_BIN ?= 'pyrope-bl2.bin'
BL2_EMMCBOOT ?= 'loader-emmc.img'
BL2_EMMC_LOAD_ADDR ?= "0xb0fe0000"
BL2_EMMC_JUMP_ADDR ?= "0xb0fe0400"
BL2_EXTRA_OPTS ?= '-m 0x40200 -b 3 -p ${NEXELL_DEV_PORTNUM} -m 0x1E0200 -b 3 -p ${NEXELL_DEV_PORTNUM} -m 0x60200 -b 3 -p ${NEXELL_DEV_PORTNUM}'

# ------------------------------------------------------------
# Nexell Dispatcher Configuration
# ------------------------------------------------------------
DISPATCHER_BUILD_CONFIG='BOARD="${NEXELL_DISPATCHER_BOARD_NAME}"'
#DISPATCHER_BUILD_CONFIG ?= 'BOARD="${NEXELL_BOARD_NAME}"'
DISPATCHER_BIN = 'armv7_dispatcher.bin'
DISPATCHER_EMMCBOOT ?= 'bl_mon.img'
DISPATCHER_EMMC_LOAD_ADDR ?= "0xffff0200"
DISPATCHER_EMMC_JUMP_ADDR ?= "0xffff0200"
DISPATCHER_EXTRA_OPTS ?= '-m 0x40200 -b 3 -p ${NEXELL_DEV_PORTNUM} -m 0x1E0200 -b 3 -p ${NEXELL_DEV_PORTNUM} -m 0x60200 -b 3 -p ${NEXELL_DEV_PORTNUM}'
DISPATCHER_FIP_NONSECURE_USB_BIN_OFFSET='35840'

# ------------------------------------------------------------
# Nexell U-Boot Configuration
# ------------------------------------------------------------
UBOOT_DEFCONFIG ?= "s5p4418_${NEXELL_BOARD_NAME}_defconfig"
UBOOT_BIN ?= 'u-boot.bin'
UBOOT_EMMCBOOT ?= 'bootloader.img'
UBOOT_EMMC_LOAD_ADDR ?= "0x43c00000"
UBOOT_EMMC_JUMP_ADDR ?= "0x43c00000"
UBBOT_FIP_NONSECURE_USB_BIN_OFFSET ?= '64512'

# ------------------------------------------------------------
# Nexell USB image Configuration
# ------------------------------------------------------------
FIP_NONSECURE_USB_BIN ?= 'fip-nonsecure-usb.bin'
FIP_LOADER_USB_IMG ?= 'fip-loader-usb.img'

# ------------------------------------------------------------
# Nexell Kernel Configuration
# ------------------------------------------------------------
KBUILD_DEFCONFIG ?= "s5p4418_${NEXELL_BOARD_NAME}_defconfig"
NEXELL_KERNEL_IMAGE_NAME ?= "zImage"
# boot partition size : 32MB
NEXELL_BOOT_PARTITION_SIZE ?= "33554432"

# ------------------------------------------------------------
# NSIH header address
# ------------------------------------------------------------
NSIH_LOAD_START_ADDRESS ?= "63c00000"

# ------------------------------------------------------------
# Nexell Environment Image Configuration
# ------------------------------------------------------------
NEXELL_ENV_PARTITION_SIZE ?= "16384"
NEXELL_ENV_BIN ?= "params.bin"
NEXELL_DEFAULT_ENVS ?= "default_envs.txt"
```

## meta-nexell-distro/conf/machine/include/s5p6818-machine.inc
```bitbake
# RAM Size : "512mb" , "1g", "2g"
NEXELL_MEM_SIZE ?= "2g"

require conf/machine/include/arm/arch-arm64.inc
include nexell-base.inc
include nexell-tools.inc
include nexell-mem-${NEXELL_MEM_SIZE}.inc

NEXELL_KERNEL_VER ?= "4"
NEXELL_DEV_PORTNUM ?= "2"
NEXELL_SYSLOG ?= "n"


# 32bit machine = 32/arm, 64bit machine = 64/arm64
ARM_ARCH = "arm64"
ARCH_TYPE_NUM = "64"
ARCH_TYPE = "arm64"

# ------------------------------------------------------------
# Nexell 2nd Boot Configuration
# ------------------------------------------------------------
# BL1
BL1_BUILD_CONFIG='BOARD="${NEXELL_BL1_BOARD_NAME}" KERNEL_VER="${NEXELL_KERNEL_VER}" SYSLOG="${NEXELL_SYSLOG}" DEVICE_PORT="${NEXELL_DEV_PORTNUM}" '
BL1_BIN='bl1-${NEXELL_BL1_IMAGE_NAME}.bin'
BL1_FINAL_BIN ?= 'bl1-${BSP_TARGET_BOARD_PREFIX}.bin'
BL1_EMMCBOOT ?= 'bl1-emmcboot.bin'
BL1_SECURE_EMMCBOOT ?= 'bl1-emmcboot.img'

# ------------------------------------------------------------
# Nexell U-Boot Configuration
# ------------------------------------------------------------
UBOOT_DEFCONFIG ?= "s5p6818_${NEXELL_BOARD_NAME}_defconfig"
UBOOT_BIN ?= 'u-boot.bin'

# ------------------------------------------------------------
# Nexell USB image Configuration
# ------------------------------------------------------------
FIP_NONSECURE_USB_BIN ?= 'fip-nonsecure-usb.bin'
FIP_LOADER_USB_IMG ?= 'fip-loader-usb.img'

# ------------------------------------------------------------
# Nexell Kernel Configuration
# ------------------------------------------------------------
KBUILD_DEFCONFIG ?= "s5p6818_${NEXELL_BOARD_NAME}_defconfig"
NEXELL_KERNEL_IMAGE_NAME ?= "Image"
# boot partition size : 64MB
NEXELL_BOOT_PARTITION_SIZE ?= "67108864"

# ------------------------------------------------------------
# Nexell optee Configuration, only s5p6818
# ------------------------------------------------------------
OPTEE_PLAT_DRAM_SIZE ?= "2048"
OPTEE_PLAT_UART_BASE ?= "0xC00A3000"
OPTEE_BUILD_TARGET_SOCNAME ?= "${NEXELL_BOARD_SOCNAME}"
OPTEE_BUILD_TARGET_MACHINE ?= "${NEXELL_BOARD_SOCNAME}-${BSP_TARGET_BOARD_NAME}"
IMAGE_INSTALL_append = " optee-build"


NEXELL_EMMC_EXTRA_OPTS ?='-m 0x60200 -b ${NEXELL_DEVID_SDMMC} -p ${NEXELL_PORT_EMMC} -m 0x1E0200 -b ${NEXELL_DEVID_SDMMC} -p ${NEXELL_PORT_EMMC}'
NEXELL_SD_EXTRA_OPTS ?='-m 0x60200 -b ${NEXELL_DEVID_SDMMC} -p ${NEXELL_PORT_SD} -m 0x1E0200 -b ${NEXELL_DEVID_SDMMC} -p ${NEXELL_PORT_SD}'
# NEXELL_USB_EXTRA_OPTS is defined in optee-build_git.bb file, because of it need to calculate size of image.
#NEXELL_USB_EXTRA_OPTS ?='-u -m ${MEM_SECURE_LOAD_ADDR} -z ${FIP_SEC_SIZE} -m ${MEM_SECURE_LOAD_ADDR} -z ${FIP_NONSEC_SIZE}'

# ------------------------------------------------------------
# Nexell Environment Image Configuration
# ------------------------------------------------------------
NEXELL_ENV_PARTITION_SIZE ?= "16384"
NEXELL_ENV_BIN ?= "params.bin"
NEXELL_DEFAULT_ENVS ?= "default_envs.txt"
```

## meta-nexell-distro/conf/machine/s5p4418-avn-ref.conf
```bitbake
#@TYPE: Machine
#@NAME: nexell

NEXELL_BOARD_NAME = "avn_ref"
NEXELL_CHIPNAME = "s5p4418"
NEXELL_DEV_PORTNUM = "2"
NEXELL_BL1_BOARD_NAME = "avn"
NEXELL_BL1_IMAGE_NAME = "avn"
NEXELL_DISPATCHER_BOARD_NAME = "AVN"

# ------------------------------------------------------------
# Nexell Kernel Configuration
# ------------------------------------------------------------
KERNEL_DEVICETREE = "s5p4418-${NEXELL_BOARD_NAME}-rev00.dtb"

# ------------------------------------------------------------
# ROOTFS Size
# ------------------------------------------------------------
# $fastboot getvar capacity.mmc.0
# 7818182656 - 0x4400000 = 7746879488
# Available rootfs Size = 7565312 Kbyte
# ------------------------------------------------------------
# Reserved yocto extra space = 102400 Kbyte for pkg. install
# IMAGE_ROOTFS_EXTRA_SPACE="0 + 102400"
# ------------------------------------------------------------
# So, 7565312 - 102400(pyro) = 7462912 Kbyte
# ------------------------------------------------------------
# IMAGE_ROOTFS_SIZE = "7462912"
# ------------------------------------------------------------
# 2018.10.05 change
# ------------------------------------------------------------
# ROOTFS = 1024MB - 128MB
# USERDATA = 6144MB(6GB)
# ------------------------------------------------------------
IMAGE_ROOTFS_SIZE = "917504"


#@DESCRIPTION: Machine configuration for nexell systems
include conf/machine/include/${BSP_TARGET_SOCNAME}-machine.inc
```

## meta-nexell-distro/conf/machine/s5p4418-convergence-daudio.conf
```bitbake
#@TYPE: Machine
#@NAME: nexell

NEXELL_BOARD_NAME = "convergence_daudio"
NEXELL_BL1_BOARD_NAME = "convergence_daudio"
NEXELL_DISPATCHER_BOARD_NAME = "NAVI"

# ------------------------------------------------------------
# Nexell Kernel Configuration
# ------------------------------------------------------------
KERNEL_DEVICETREE = "s5p4418-${NEXELL_BOARD_NAME}-rev00.dtb s5p4418-${NEXELL_BOARD_NAME}-rev01.dtb"

# ------------------------------------------------------------
# ROOTFS Size
# ------------------------------------------------------------
# $fastboot getvar capacity.mmc.0
# 7818182656 - 0x4400000 = 7746879488
# Available rootfs Size = 7565312 Kbyte
# ------------------------------------------------------------
# Reserved yocto extra space = 102400 Kbyte for pkg. install
# IMAGE_ROOTFS_EXTRA_SPACE="0 + 102400"
# ------------------------------------------------------------
# So, 7565312 - 102400(pyro) = 7462912 Kbyte
# ------------------------------------------------------------
# IMAGE_ROOTFS_SIZE = "2097152"
# ------------------------------------------------------------
# 2018.10.05 change
# ------------------------------------------------------------
# ROOTFS = 1024MB - 128MB
# USERDATA = 6144MB(6GB)
# ------------------------------------------------------------
IMAGE_ROOTFS_SIZE = "917504"

# for qtbootlauncher time
BOOTTIME_LAUNCHER = "1600000"

# ------------------------------------------------------------
# NSIH header address
# ------------------------------------------------------------
NEXELL_NSIH_LOAD_START_ADDRESS = "63c00000"

# ------------------------------------------------------------
# Nexell Etc Configuration
# ------------------------------------------------------------
# override touch class, capacitive touchscreen
NEXELL_TOUCH_CLASS = "CAPACITIVE"

# Nexell quickboot enabler
QUICKBOOT_ENABLE = "1"


#@DESCRIPTION: Machine configuration for nexell systems
include conf/machine/include/${BSP_TARGET_SOCNAME}-machine.inc
```
