## meta-nexell-distro/conf/machine/s5p4418-convergence-svmc.conf
```bitbake
#@TYPE: Machine
#@NAME: nexell

NEXELL_BOARD_NAME = "convergence_svmc"
NEXELL_BL1_BOARD_NAME = "convergence_svmc"
NEXELL_BL1_IMAGE_NAME = "convergence_svmc"
NEXELL_DISPATCHER_BOARD_NAME = "CONVERGENCESVMC"

# ------------------------------------------------------------
# Nexell Kernel Configuration
# ------------------------------------------------------------
KERNEL_DEVICETREE = "s5p4418-${NEXELL_BOARD_NAME}-rev00.dtb s5p4418-${NEXELL_BOARD_NAME}-rev01.dtb"
#MACHINE_ESSENTIAL_EXTRA_RRECOMMENDS += "rtl-8188eus-32"
#MACHINE_ESSENTIAL_EXTRA_RRECOMMENDS += "kernel-modules"

# ------------------------------------------------------------
# ROOTFS Size
# ------------------------------------------------------------
# $fastboot getvar capacity.mmc.0
# 7818182656 - 0x4400000 = 7746879488
# Available rootfs Size = 7565312 Kbyte
# ------------------------------------------------------------
# Reserved yocto extra space = 102400 Kbyte for pkg. install
# IMAGE_ROOTFS_EXTRA_SPACE="0 + 102400"
# ------------------------------------------------------------
# So, 7565312 - 102400(pyro) = 7462912 Kbyte
# ------------------------------------------------------------
# IMAGE_ROOTFS_SIZE = "2097152"
# ------------------------------------------------------------
# 2018.10.05 change
# ------------------------------------------------------------
# ROOTFS = 1024MB - 128MB
# USERDATA = 6144MB(6GB)
# ------------------------------------------------------------
IMAGE_ROOTFS_SIZE = "917504"

# ------------------------------------------------------------
# Nexell Etc Configuration
# ------------------------------------------------------------
# override touch class, capacitive touchscreen
NEXELL_TOUCH_CLASS = "CAPACITIVE"

# Nexell quickboot enabler
QUICKBOOT_ENABLE = "1"

# ------------------------------------------------------------
# Nexell User Partition Configuration
# ------------------------------------------------------------
NEXELL_USER_PARTITION_SIZE ?= "4G"
NEXELL_ROOT_PARTITION_SIZE ?= "3221225472"
# ------------------------------------------------------------
# Nexell U-boot env Configuration
# ------------------------------------------------------------

UBOOT_BOOTARGS ?= "console=ttyAMA3,115200n8"
UBOOT_BOOTARGS += "root=\/dev\/mmcblk0p5 rw rootfstype=ext4"
UBOOT_BOOTARGS += "init=\/sbin\/nx_init loglevel=4 rootwait quiet printk.time=1"
UBOOT_BOOTARGS += "misc_part=\/dev\/mmcblk0p3"
UBOOT_BOOTARGS += "consoleblank=0 coherent_pool=4M systemd.log_level=info"
UBOOT_BOOTARGS += "systemd.show_status=false"
UBOOT_BOOTARGS += "nx_drm.fb_buffers=3 nx_drm.fb_pan_crtcs=0x1"
UBOOT_BOOTARGS += "nx_drm.fb_conns=1 nx_drm.fb_argb=1"

UBOOT_RECOVERYBOOT_ARGS ?= "setenv bootargs console=ttyAMA3,115200n8"
UBOOT_RECOVERYBOOT_ARGS += "root=\/dev\/ram0 loglevel=4 printk.time=1"
UBOOT_RECOVERYBOOT_ARGS += "consoleblank=0"
UBOOT_RECOVERYBOOT_ARGS += "rdinit=\/sbin\/nx_init"
UBOOT_RECOVERYBOOT_ARGS += "misc_part=\/dev\/mmcblk0p3"
UBOOT_RECOVERYBOOT_ARGS += "nx_drm.fb_buffers=3 nx_drm.fb_pan_crtcs=0x1"
UBOOT_RECOVERYBOOT_ARGS += "nx_drm.fb_conns=1 nx_drm.fb_argb=0;"
UBOOT_RECOVERYBOOT_ARGS += "run boot_cmd_ramfsboot;"
#		"

#@DESCRIPTION: Machine configuration for nexell systems
include conf/machine/include/${BSP_TARGET_SOCNAME}-machine.inc
```

## meta-nexell-distro/conf/machine/s5p4418-daudio-covi.conf
```bitbake
#@TYPE: Machine
#@NAME: nexell

NEXELL_BOARD_NAME = "daudio_covi"
NEELL_BL1_BOARD_NAME = "daudio"
NEXELL_DISPATCHER_BOARD_NAME = "DAUDIOCOVI"

# ------------------------------------------------------------
# Nexell Kernel Configuration
# ------------------------------------------------------------
KERNEL_DEVICETREE = "s5p4418-${NEXELL_BOARD_NAME}-rev00.dtb"

# ------------------------------------------------------------
# ROOTFS Size
# ------------------------------------------------------------
# daudio rootfs size = 512 Mbyte
# 524288 Kbyte
# ------------------------------------------------------------
# Reserved yocto extra space = 102400 Kbyte for pkg. install
# IMAGE_ROOTFS_EXTRA_SPACE="0 + 102400"
# ------------------------------------------------------------
# So, 524288 - 51200(Krogoth) = 473088 Kbyte
# ------------------------------------------------------------
IMAGE_ROOTFS_SIZE = "473088"

# ------------------------------------------------------------
# NSIH header address
# ------------------------------------------------------------
NSIH_LOAD_START_ADDRESS = "83c00000"

# ------------------------------------------------------------
# Nexell Etc Configuration
# ------------------------------------------------------------
# override touch class, capacitive touchscreen
NEXELL_TOUCH_CLASS = "CAPACITIVE"


#@DESCRIPTION: Machine configuration for nexell systems
include conf/machine/include/${BSP_TARGET_SOCNAME}-machine.inc
```

## meta-nexell-distro/conf/machine/s5p4418-daudio-ref.conf
```bitbake
#@TYPE: Machine
#@NAME: nexell

NEXELL_BOARD_NAME = "daudio_ref"
NEXELL_BL1_BOARD_NAME = "navi"
NEXELL_BL1_IMAGE_NAME = "navi"
NEXELL_DISPATCHER_BOARD_NAME = "NAVI"

# ------------------------------------------------------------
# Nexell Kernel Configuration
# ------------------------------------------------------------
KERNEL_DEVICETREE = "s5p4418-${NEXELL_BOARD_NAME}-rev00.dtb s5p4418-${NEXELL_BOARD_NAME}-rev01.dtb"

# ------------------------------------------------------------
# ROOTFS Size
# ------------------------------------------------------------
# $fastboot getvar capacity.mmc.0
# 7818182656 - 0x4400000 = 7746879488
# Available rootfs Size = 7565312 Kbyte
# ------------------------------------------------------------
# Reserved yocto extra space = 102400 Kbyte for pkg. install
# IMAGE_ROOTFS_EXTRA_SPACE="0 + 102400"
# ------------------------------------------------------------
# So, 7565312 - 102400 = 7462912 Kbyte
# DAUDIO 768MB, 786432 - 102400 = 684032 Kbyte
# ------------------------------------------------------------
IMAGE_ROOTFS_SIZE = "684032"

# ------------------------------------------------------------
# Nexell Etc Configuration
# ------------------------------------------------------------
# Nexell quickboot enabler
QUICKBOOT_ENABLE = "1"

# for qtbootlauncher time
BOOTTIME_LAUNCHER = "1600000"

NEXELL_USER_PARTITION_SIZE ?= "4G"
NEXELL_ROOT_PARTITION_SIZE ?= "3221225472"

#@DESCRIPTION: Machine configuration for nexell systems
include conf/machine/include/${BSP_TARGET_SOCNAME}-machine.inc
```

## meta-nexell-distro/conf/machine/s5p4418-ff-voice.conf
```bitbake
#@TYPE: Machine
#@NAME: nexell

NEXELL_BOARD_NAME = "ff_voice"
NEXELL_BL1_BOARD_NAME = "ff_voice"
NEXELL_DISPATCHER_BOARD_NAME = "FFVOICE"

# ------------------------------------------------------------
# Nexell Kernel Configuration
# ------------------------------------------------------------
KERNEL_DEVICETREE = "s5p4418-${NEXELL_BOARD_NAME}.dtb"

# ------------------------------------------------------------
# ROOTFS Size
# ------------------------------------------------------------
# $fastboot getvar capacity.mmc.0
# 7818182656 - 0x4400000 = 7746879488
# Available rootfs Size = 7565312 Kbyte
# ------------------------------------------------------------
# Reserved yocto extra space = 102400 Kbyte for pkg. install
# IMAGE_ROOTFS_EXTRA_SPACE="0 + 102400"
# ------------------------------------------------------------
# So, 7565312 - 102400(pyro) = 7462912 Kbyte
# real ext4 size 7565312
# ------------------------------------------------------------
#IMAGE_ROOTFS_SIZE = "7462912"
# ------------------------------------------------------------
# 2018.10.05 change
# ------------------------------------------------------------
# ROOTFS = 1024MB - 128MB
# USERDATA = 6144MB(6GB)
# ------------------------------------------------------------
IMAGE_ROOTFS_SIZE = "917504"

# ramdisk image override
INITRAMFS_IMAGE = "nexell-ramdisk-tiny"
PACKAGE_INSTALL_append_pn-nexell-ramdisk-tiny = " farfield-update"

# ------------------------------------------------------------
# NSIH header address
# ------------------------------------------------------------
NSIH_LOAD_START_ADDRESS = "a2000000"

# ------------------------------------------------------------
# Nexell User Partition Configuration
# ------------------------------------------------------------
NEXELL_USER_PARTITION_SIZE = "1G"

#@DESCRIPTION: Machine configuration for nexell systems
include conf/machine/include/${BSP_TARGET_SOCNAME}-machine.inc
```

## meta-nexell-distro/conf/machine/s5p4418-navi-ref.conf
```bitbake
#@TYPE: Machine
#@NAME: nexell

NEXELL_BOARD_NAME = "navi_ref"
NEXELL_BL1_BOARD_NAME = "navi"
NEXELL_BL1_IMAGE_NAME = "navi"
NEXELL_DISPATCHER_BOARD_NAME = "NAVI"

# ------------------------------------------------------------
# Nexell Kernel Configuration
# ------------------------------------------------------------
KERNEL_DEVICETREE = "s5p4418-${NEXELL_BOARD_NAME}-rev00.dtb s5p4418-${NEXELL_BOARD_NAME}-rev01.dtb"

# ------------------------------------------------------------
# ROOTFS Size
# ------------------------------------------------------------
# $fastboot getvar capacity.mmc.0
# 7818182656 - 0x4400000 = 7746879488
# Available rootfs Size = 7565312 Kbyte
# ------------------------------------------------------------
# Reserved yocto extra space = 102400 Kbyte for pkg. install
# IMAGE_ROOTFS_EXTRA_SPACE="0 + 102400"
# ------------------------------------------------------------
# So, 7565312 - 102400 = 7462912 Kbyte
# DAUDIO 768MB, 786432 - 102400 = 684032 Kbyte
# ------------------------------------------------------------
IMAGE_ROOTFS_SIZE = "684032"

# ------------------------------------------------------------
# Nexell Etc Configuration
# ------------------------------------------------------------
# Nexell quickboot enabler
QUICKBOOT_ENABLE = "1"

#@DESCRIPTION: Machine configuration for nexell systems
include conf/machine/include/${BSP_TARGET_SOCNAME}-machine.inc
```

## meta-nexell-distro/conf/machine/s5p4418-smart-voice.conf
```bitbake
#@TYPE: Machine
#@NAME: nexell

NEXELL_BOARD_NAME = "smart_voice"
NEXELL_BL1_BOARD_NAME = "smart_voice"
NEXELL_DISPATCHER_BOARD_NAME = "SMARTVOICE"
# RAM Size : "512mb" , "1g", "2g"
NEXELL_MEM_SIZE = "1g"

# ------------------------------------------------------------
# Nexell Kernel Configuration
# ------------------------------------------------------------
KERNEL_DEVICETREE = "s5p4418-${NEXELL_BOARD_NAME}.dtb"

# ------------------------------------------------------------
# ROOTFS Size
# ------------------------------------------------------------
# smart-voice rootfs size = 7.3GiB
# 7GiB ==> 7340032KB
# ------------------------------------------------------------
# Reserved yocto extra space = 51200 Kbyte for pkg. install
# Krogoth => 51200
# Pyro ==> 102400
# ------------------------------------------------------------
# Real RootFS Size =  7340032 - 102400 -32 = 7237600 KB
# ------------------------------------------------------------
# IMAGE_ROOTFS_SIZE = "7237600"
# ------------------------------------------------------------
# 2018.10.05 change
# ------------------------------------------------------------
# ROOTFS = 1024MB - 128MB
# USERDATA = 6144MB(6GB)
# ------------------------------------------------------------
IMAGE_ROOTFS_SIZE = "917504"

# ------------------------------------------------------------
# NSIH header address
# ------------------------------------------------------------
NSIH_LOAD_START_ADDRESS = "83c00000"

# ------------------------------------------------------------
# Nexell User Partition Configuration
# ------------------------------------------------------------
NEXELL_USER_PARTITION_SIZE = "1G"

#@DESCRIPTION: Machine configuration for nexell systems
include conf/machine/include/${BSP_TARGET_SOCNAME}-machine.inc
```

## meta-nexell-distro/conf/machine/s5p4418.conf
```bitbake
#@TYPE: Machine
#@NAME: s5p4418

MACHINE ?= "s5p4418"

#@DESCRIPTION: Machine configuration for nexell systems
include conf/machine/include/s5p4418-machine.inc
```

## meta-nexell-distro/conf/machine/s5p6818-avn-ref.conf
```bitbake
#@TYPE: Machine
#@NAME: nexell

NEXELL_BOARD_NAME = "avn_ref"
NEXELL_BL1_BOARD_NAME = "avn"
NEXELL_BL1_IMAGE_NAME = "avn"
# RAM Size : "512mb" , "1g", "2g"
#NEXELL_MEM_SIZE = "2g"

# ------------------------------------------------------------
# Nexell Kernel Configuration
# ------------------------------------------------------------
KERNEL_DEVICETREE = "nexell/s5p6818-avn-ref-rev01.dtb"
KERNEL_DTB_NAME = "s5p6818-avn-ref-rev01.dtb"

# ------------------------------------------------------------
# Nexell optee Configuration, only s5p6818
# ------------------------------------------------------------
OPTEE_PLAT_DRAM_SIZE="2048"
OPTEE_PLAT_UART_BASE="0xC00A3000"

# ------------------------------------------------------------
# ROOTFS Size
# ------------------------------------------------------------
# $fastboot getvar capacity.mmc.0
# 7818182656 - 0x6400000 = 7713325056
# Available rootfs Size = 7532544 Kbyte
# ------------------------------------------------------------
# Reserved yocto extra space = 102400 Kbyte for pkg. install
# IMAGE_ROOTFS_EXTRA_SPACE="0 + 102400"
# ------------------------------------------------------------
# So, 7532544 - 102400(pyro) - 32768(margin)= 7397376 Kbyte
# ------------------------------------------------------------
# IMAGE_ROOTFS_SIZE = "7397376"
# ------------------------------------------------------------
# 2018.10.05 change
# ------------------------------------------------------------
# ROOTFS = 1024MB - 128MB
# USERDATA = 6144MB(6GB)
# ------------------------------------------------------------
IMAGE_ROOTFS_SIZE = "917504"

# ------------------------------------------------------------
# Nexell Etc Configuration
# ------------------------------------------------------------
# override touch class, capacitive touchscreen
NEXELL_TOUCH_CLASS = "CAPACITIVE"


#@DESCRIPTION: Machine configuration for nexell systems
include conf/machine/include/${BSP_TARGET_SOCNAME}-machine.inc
```
