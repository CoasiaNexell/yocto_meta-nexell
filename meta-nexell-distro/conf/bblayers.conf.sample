## meta-nexell-distro/conf/machine/s5p6818-convergence-svmc.conf
```bitbake
#@TYPE: Machine
#@NAME: nexell

NEXELL_BOARD_NAME = "convergence_svmc"
NEXELL_BL1_BOARD_NAME = "convergence"
NEXELL_BL1_IMAGE_NAME = "convergence"
# RAM Size : "512mb" , "1g", "2g"
#NEXELL_MEM_SIZE = "2g"

# ------------------------------------------------------------
# Nexell Kernel Configuration
# ------------------------------------------------------------
KERNEL_DEVICETREE = "nexell/s5p6818-convergence_svmc-rev01.dtb"
KERNEL_DTB_NAME = "s5p6818-convergence_svmc-rev01.dtb"

# ------------------------------------------------------------
# Nexell optee Configuration, only s5p6818
# ------------------------------------------------------------
OPTEE_PLAT_DRAM_SIZE="2048"
OPTEE_PLAT_UART_BASE="0xC00A3000"

# ------------------------------------------------------------
# ROOTFS Size
# ------------------------------------------------------------
# $fastboot getvar capacity.mmc.0
# 7818182656 - 0x4400000 = 7746879488
# Available rootfs Size = 7565312 Kbyte
# ------------------------------------------------------------
# Reserved yocto extra space = 102400 Kbyte for pkg. install
# IMAGE_ROOTFS_EXTRA_SPACE="0 + 102400"
# ------------------------------------------------------------
# So, 7565312 - 102400 = 7462912 Kbyte
# DAUDIO 768MB, 786432 - 102400 = 684032 Kbyte
# ------------------------------------------------------------
IMAGE_ROOTFS_SIZE = "684032"

# ------------------------------------------------------------
# Nexell Etc Configuration
# ------------------------------------------------------------
# override touch class, capacitive touchscreen
NEXELL_TOUCH_CLASS = "CAPACITIVE"


NEXELL_USER_PARTITION_SIZE ?= "4G"
NEXELL_ROOT_PARTITION_SIZE ?= "3221225472"

# ------------------------------------------------------------
# Nexell Etc Configuration
# ------------------------------------------------------------
# Nexell override
SERIAL_CONSOLE = "115200 ttySAC0"

#@DESCRIPTION: Machine configuration for nexell systems
include conf/machine/include/${BSP_TARGET_SOCNAME}-machine.inc
```

## meta-nexell-distro/conf/machine/s5p6818-kick-st.conf
```bitbake
#@TYPE: Machine
#@NAME: nexell

NEXELL_BOARD_NAME = "kick_st"
NEXELL_BL1_BOARD_NAME = "kick_st"
NEXELL_BL1_IMAGE_NAME = "kick_st"
# RAM Size : "512mb" , "1g", "2g"
#NEXELL_MEM_SIZE = "2g"

# ------------------------------------------------------------
# Nexell Kernel Configuration
# ------------------------------------------------------------
KERNEL_DEVICETREE = "nexell/s5p6818-kick-st.dtb nexell/s5p6818-kick-st-rev00.dtb"
KERNEL_DTB_NAME = "s5p6818-kick-st-rev00.dtb"

# ------------------------------------------------------------
# ROOTFS Size
# ------------------------------------------------------------
# $fastboot getvar capacity.mmc.0
# 7818182656 - 0x6400000 = 7713325056
# Available rootfs Size = 7532544 Kbyte
# ------------------------------------------------------------
# Reserved yocto extra space = 102400 Kbyte for pkg. install
# IMAGE_ROOTFS_EXTRA_SPACE="0 + 102400"
# ------------------------------------------------------------
# So, 7532544 - 102400(pyro) - 16384(margin)= 7413760 Kbyte
# ------------------------------------------------------------
# IMAGE_ROOTFS_SIZE = "7413760"
# ------------------------------------------------------------
# 2018.10.05 change
# ------------------------------------------------------------
# ROOTFS = 1024MB - 128MB
# USERDATA = 6144MB(6GB)
# ------------------------------------------------------------
IMAGE_ROOTFS_SIZE = "917504"

# ------------------------------------------------------------
# Nexell Etc Configuration
# ------------------------------------------------------------
# override touch class, capacitive touchscreen
NEXELL_TOUCH_CLASS = "CAPACITIVE"

#@DESCRIPTION: Machine configuration for nexell systems
include conf/machine/include/${BSP_TARGET_SOCNAME}-machine.inc
```

## meta-nexell-distro/conf/machine/s5p6818.conf
```bitbake
#@TYPE: Machine
#@NAME: s5p6818

MACHINE ?= "s5p6818"

#@DESCRIPTION: Machine configuration for nexell systems
include conf/machine/include/s5p6818-machine.inc
```
